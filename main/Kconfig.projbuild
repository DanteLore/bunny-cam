## main/Kconfig.projbuild
```kconfig
menu "Bunny Cam"

    config WIFI_SSID
        string "WiFi SSID"
        default "myssid"
        help
            SSID of the WiFi network to connect to.

    config WIFI_PASSWORD
        string "WiFi password"
        default "mypassword"
        help
            Password for the WiFi network.

    config UPLOAD_SECRET
        string "Upload secret"
        default ""
        help
            Shared secret for the webcam upload API.

endmenu
```

## sdkconfig.defaults
```kconfig
# Flash -- 4MB chip, custom partition table with 3MB app partition
CONFIG_ESPTOOLPY_FLASHSIZE_4MB=y
CONFIG_PARTITION_TABLE_CUSTOM=y
CONFIG_PARTITION_TABLE_CUSTOM_FILENAME="partitions.csv"

# Main task stack -- needs headroom for camera init, upload buffers, and HTTP client
CONFIG_ESP_MAIN_TASK_STACK_SIZE=16384

# Watchdog -- 60s covers the 30s upload cycle plus 10s HTTP timeout with headroom
CONFIG_ESP_TASK_WDT_TIMEOUT_S=60

# PSRAM -- required for camera frame buffer allocation
CONFIG_SPIRAM=y
CONFIG_SPIRAM_MODE_QUAD=y
CONFIG_SPIRAM_SPEED_40M=y
CONFIG_SPIRAM_BOOT_INIT=y
```
